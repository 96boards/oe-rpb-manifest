## conf/bblayers.conf
```bitbake
# LAYER_CONF_VERSION is increased each time build/conf/bblayers.conf
# changes incompatibly
LCONF_VERSION = "7"
OEROOT := "${@os.path.abspath(os.path.dirname(d.getVar('FILE', True)))}/../.."

BBPATH = "${TOPDIR}"

BBFILES = ""

# These layers hold recipe metadata not found in OE-core, but lack any machine or distro content
BASELAYERS ?= " \
  ${OEROOT}/layers/meta-openembedded/meta-oe \
  ${OEROOT}/layers/meta-openembedded/meta-gnome \
  ${OEROOT}/layers/meta-openembedded/meta-xfce \
  ${OEROOT}/layers/meta-openembedded/meta-initramfs \
  ${OEROOT}/layers/meta-openembedded/meta-multimedia \
  ${OEROOT}/layers/meta-openembedded/meta-networking \
  ${OEROOT}/layers/meta-openembedded/meta-webserver \
  ${OEROOT}/layers/meta-openembedded/meta-filesystems \
  ${OEROOT}/layers/meta-openembedded/meta-perl \
  ${OEROOT}/layers/meta-openembedded/meta-python \
  ${OEROOT}/layers/meta-browser/meta-chromium \
  ${OEROOT}/layers/meta-qt5 \
  ${OEROOT}/layers/meta-virtualization \
  ${OEROOT}/layers/meta-clang \
  ${OEROOT}/layers/meta-python2 \
"

# These layers hold machine specific content, aka Board Support Packages
BSPLAYERS ?= " \
  ${OEROOT}/layers/meta-arm/meta-arm \
  ${OEROOT}/layers/meta-intel \
  ${OEROOT}/layers/meta-qcom \
  ${OEROOT}/layers/meta-96boards \
  ${OEROOT}/layers/meta-ti \
  ${OEROOT}/layers/meta-freescale \
"

# Add your overlay location to EXTRALAYERS
# Make sure to have a conf/layers.conf in there
EXTRALAYERS ?= " \
  ${OEROOT}/layers/meta-linaro/meta-linaro \
  ${OEROOT}/layers/meta-arm/meta-arm-toolchain \
"

BBLAYERS = " \
  ${OEROOT}/layers/meta-rpb \
  ${BASELAYERS} \
  ${BSPLAYERS} \
  ${EXTRALAYERS} \
  ${OEROOT}/layers/openembedded-core/meta \
"
```
